## config/west.yml
```yaml
manifest:

  remotes:
    - name: official # Official ZMK
      url-base: https://github.com/zmkfirmware
    - name: personal # Personal patched variant of ZMK
      url-base: https://github.com/maverick1872
    - name: urob # Patched variant of ZMK
      url-base: https://github.com/urob

  projects:
    - name: zmk
      remote: official
      revision: main
      import: app/west.yml
    - name: zmk-helpers
      remote: urob
      revision: main
      path: modules/zmk-helpers

  self:
    path: config
```
