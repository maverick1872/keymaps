#include "../../zmk-nodefree-config/keypos_def/keypos_42keys.h"

// Convenience definitions for keys on each side of the keyboard, with thumb keys as a standalone.
#define KEYS_L LT0 LT1 LT2 LT3 LT4 LT5 LM0 LM1 LM2 LM3 LM4 LM5 LB0 LB1 LB2 LB3 LB4 LB5
#define KEYS_R RT0 RT1 RT2 RT3 RT4 RT5 RM0 RM1 RM2 RM3 RM4 LM5 RB0 RB1 RB2 RB3 RB4 RB5
#define THUMBS LH2 LH1 LH0 RH0 RH1 RH2

// Homeerow mods configurations
#define HM_TAPPING_TERM 200
#define HM_QUICK_TAP_TERM 175
#define HM_PRIOR_IDLE 150
